const CStar StarList[] = {
    // {Name,                Const,VisMag, RightAscension,        Declination},
    {"",                     "AND",  3.27, HmsToDeg( 0, 39.2, 0), DmsToDeg(+30, 50, 0)},
    {"",                     "AQL",  2.99, HmsToDeg(19,  5.3, 0), DmsToDeg(+13, 52, 0)},
    {"",                     "AQL",  3.23, HmsToDeg(20, 11.2, 0), DmsToDeg( -0, 50, 0)},
    {"",                     "AQL",  3.36, HmsToDeg(19, 25.4, 0), DmsToDeg( +3,  7, 0)},
    {"",                     "AQL",  3.44, HmsToDeg(19,  6.1, 0), DmsToDeg( -4, 53, 0)},
    {"",                     "AQL",  3.90, HmsToDeg(19, 52.3, 0), DmsToDeg( +1,  0, 0)},
    {"",                     "ARA",  2.85, HmsToDeg(17, 25.0, 0), DmsToDeg(-55, 31, 0)},
    {"",                     "ARA",  2.95, HmsToDeg(17, 31.6, 0), DmsToDeg(-49, 52, 0)},
    {"",                     "ARA",  3.13, HmsToDeg(16, 58.3, 0), DmsToDeg(-55, 59, 0)},
    {"",                     "ARA",  3.34, HmsToDeg(17, 25.1, 0), DmsToDeg(-56, 22, 0)},
    {"",                     "AUR",  2.62, HmsToDeg( 5, 59.5, 0), DmsToDeg(+37, 13, 0)},
    {"",                     "AUR",  2.69, HmsToDeg( 4, 56.8, 0), DmsToDeg(+33, 10, 0)},
    {"",                     "BOO",  3.47, HmsToDeg(15, 15.3, 0), DmsToDeg(+33, 20, 0)},
    {"",                     "CMA",  3.02, HmsToDeg( 7,  3.0, 0), DmsToDeg(-23, 50, 0)},
    {"",                     "CMA",  3.50, HmsToDeg( 7,  1.5, 0), DmsToDeg(-27, 56, 0)},
    {"",                     "CAP",  2.90, HmsToDeg(21, 46.9, 0), DmsToDeg(-16,  9, 0)},
    {"",                     "CAR",  2.76, HmsToDeg(10, 42.8, 0), DmsToDeg(-64, 22, 0)},
    {"",                     "CAR",  3.01, HmsToDeg( 9, 46.9, 0), DmsToDeg(-65,  3, 0)},
    {"",                     "CAR",  3.32, HmsToDeg(10, 13.6, 0), DmsToDeg(-70,  1, 0)},
    {"",                     "CAR",  3.47, HmsToDeg( 7, 56.7, 0), DmsToDeg(-52, 58, 0)},
    {"",                     "CAS",  2.50, HmsToDeg( 0, 56.6, 0), DmsToDeg(+60, 42, 0)},
    {"",                     "CAS",  3.44, HmsToDeg( 0, 49.0, 0), DmsToDeg(+57, 48, 0)},
    {"",                     "CEN",  1.33, HmsToDeg(14, 39.5, 0), DmsToDeg(-60, 50, 0)},
    {"",                     "CEN",  2.30, HmsToDeg(14, 35.3, 0), DmsToDeg(-42,  9, 0)},
    {"",                     "CEN",  2.30, HmsToDeg(13, 39.7, 0), DmsToDeg(-53, 27, 0)},
    {"",                     "CEN",  2.55, HmsToDeg(13, 55.4, 0), DmsToDeg(-47, 16, 0)},
    {"",                     "CEN",  2.60, HmsToDeg(12,  8.2, 0), DmsToDeg(-50, 42, 0)},
    {"",                     "CEN",  2.75, HmsToDeg(13, 20.4, 0), DmsToDeg(-36, 41, 0)},
    {"",                     "CEN",  2.87, HmsToDeg(12, 41.3, 0), DmsToDeg(-48, 56, 0)},
    {"",                     "CEN",  2.96, HmsToDeg(12, 41.3, 0), DmsToDeg(-48, 56, 0)},
    {"",                     "CEN",  3.00, HmsToDeg(13, 49.5, 0), DmsToDeg(-42, 27, 0)},
    {"",                     "CEN",  3.13, HmsToDeg(11, 35.7, 0), DmsToDeg(-63,  0, 0)},
    {"",                     "CEN",  3.13, HmsToDeg(14, 59.0, 0), DmsToDeg(-42,  5, 0)},
    {"",                     "CEN",  3.41, HmsToDeg(13, 49.4, 0), DmsToDeg(-41, 40, 0)},
    {"",                     "CEP",  3.35, HmsToDeg(22, 10.7, 0), DmsToDeg(+58, 11, 0)},
    {"",                     "CEP",  3.43, HmsToDeg(20, 45.2, 0), DmsToDeg(+61, 49, 0)},
    {"",                     "CEP",  3.52, HmsToDeg(22, 49.5, 0), DmsToDeg(+66, 11, 0)},
    {"",                     "CEP",  4.00, HmsToDeg(22, 29.0, 0), DmsToDeg(+58, 24, 0)},
    {"",                     "CET",  3.45, HmsToDeg( 1,  8.5, 0), DmsToDeg(-10, 12, 0)},
    {"",                     "CET",  3.50, HmsToDeg( 1, 44.0, 0), DmsToDeg(-15, 58, 0)},
    {"",                     "CIR",  3.19, HmsToDeg(14, 42.2, 0), DmsToDeg(-64, 58, 0)},
    {"",                     "CRB",  2.00, HmsToDeg(15, 59.3, 0), DmsToDeg(+25, 56, 0)},
    {"",                     "CRU",  1.73, HmsToDeg(12, 26.4, 0), DmsToDeg(-63,  4, 0)},
    {"",                     "CRU",  2.80, HmsToDeg(12, 15.0, 0), DmsToDeg(-58, 43, 0)},
    {"",                     "CYG",  2.46, HmsToDeg(20, 46.0, 0), DmsToDeg(+33, 57, 0)},
    {"",                     "CYG",  2.87, HmsToDeg(19, 44.8, 0), DmsToDeg(+45,  7, 0)},
    {"",                     "CYG",  3.20, HmsToDeg(21, 12.9, 0), DmsToDeg(+30, 12, 0)},
    {"",                     "DOR",  3.27, HmsToDeg( 4, 33.9, 0), DmsToDeg(-55,  3, 0)},
    {"",                     "DOR",  3.80, HmsToDeg( 5, 33.6, 0), DmsToDeg(-62, 30, 0)},
    {"",                     "DRA",  2.74, HmsToDeg(16, 23.9, 0), DmsToDeg(+61, 31, 0)},
    {"",                     "ERI",  3.54, HmsToDeg( 3, 43.1, 0), DmsToDeg( -9, 47, 0)},
    {"",                     "GRU",  2.10, HmsToDeg(22, 42.5, 0), DmsToDeg(-46, 54, 0)},
    {"",                     "GRU",  3.01, HmsToDeg(21, 53.8, 0), DmsToDeg(-37, 23, 0)},
    {"",                     "GRU",  3.49, HmsToDeg(22, 48.4, 0), DmsToDeg(-51, 20, 0)},
    {"",                     "HER",  2.81, HmsToDeg(16, 41.1, 0), DmsToDeg(+31, 36, 0)},
    {"",                     "HER",  3.16, HmsToDeg(17, 14.9, 0), DmsToDeg(+36, 49, 0)},
    {"",                     "HER",  3.42, HmsToDeg(17, 46.2, 0), DmsToDeg(+27, 44, 0)},
    {"",                     "HER",  3.53, HmsToDeg(16, 42.7, 0), DmsToDeg(+38, 56, 0)},
    {"",                     "HYA",  3.00, HmsToDeg(13, 18.7, 0), DmsToDeg(-23,  9, 0)},
    {"",                     "HYA",  3.11, HmsToDeg(10, 49.5, 0), DmsToDeg(-16, 10, 0)},
    {"",                     "HYA",  3.11, HmsToDeg( 8, 55.2, 0), DmsToDeg( +5, 58, 0)},
    {"",                     "HYA",  3.27, HmsToDeg(14,  6.2, 0), DmsToDeg(-26, 40, 0)},
    {"",                     "HYA",  3.38, HmsToDeg( 8, 46.6, 0), DmsToDeg( +6, 26, 0)},
    {"",                     "HYA",  3.54, HmsToDeg(11, 32.9, 0), DmsToDeg(-31, 50, 0)},
    {"",                     "HYI",  2.80, HmsToDeg( 0, 25.4, 0), DmsToDeg(-77, 17, 0)},
    {"",                     "HYI",  2.86, HmsToDeg( 1, 58.7, 0), DmsToDeg(-61, 36, 0)},
    {"",                     "HYI",  3.24, HmsToDeg( 3, 47.3, 0), DmsToDeg(-74, 15, 0)},
    {"",                     "IND",  3.11, HmsToDeg(20, 37.3, 0), DmsToDeg(-47, 19, 0)},
    {"",                     "LEO",  3.47, HmsToDeg(10, 19.8, 0), DmsToDeg(+19, 52, 0)},
    {"",                     "LEO",  3.52, HmsToDeg(10,  7.2, 0), DmsToDeg(+16, 47, 0)},
    {"",                     "LEP",  2.84, HmsToDeg( 5, 28.2, 0), DmsToDeg(-20, 46, 0)},
    {"",                     "LEP",  3.19, HmsToDeg( 5,  5.3, 0), DmsToDeg(-22, 23, 0)},
    {"",                     "LEP",  3.30, HmsToDeg( 5, 12.8, 0), DmsToDeg(-16, 13, 0)},
    {"",                     "LEP",  3.55, HmsToDeg( 5, 46.9, 0), DmsToDeg(-14, 50, 0)},
    {"",                     "LUP",  2.30, HmsToDeg(14, 41.7, 0), DmsToDeg(-47, 23, 0)},
    {"",                     "LUP",  2.68, HmsToDeg(14, 58.3, 0), DmsToDeg(-43,  7, 0)},
    {"",                     "LUP",  2.78, HmsToDeg(15, 34.9, 0), DmsToDeg(-41,  9, 0)},
    {"",                     "LUP",  3.20, HmsToDeg(15, 21.2, 0), DmsToDeg(-40, 38, 0)},
    {"",                     "LUP",  3.37, HmsToDeg(15, 22.5, 0), DmsToDeg(-44, 40, 0)},
    {"",                     "LUP",  3.41, HmsToDeg(15, 12.0, 0), DmsToDeg(-52,  5, 0)},
    {"",                     "LUP",  3.41, HmsToDeg(15, 59.9, 0), DmsToDeg(-38, 23, 0)},
    {"",                     "LUP",  3.55, HmsToDeg(14, 19.2, 0), DmsToDeg(-46,  3, 0)},
    {"",                     "LYN",  3.13, HmsToDeg( 9, 20.9, 0), DmsToDeg(+34, 24, 0)},
    {"",                     "MUS",  2.69, HmsToDeg(12, 37.0, 0), DmsToDeg(-69,  7, 0)},
    {"",                     "MUS",  3.05, HmsToDeg(12, 46.1, 0), DmsToDeg(-68,  5, 0)},
    {"",                     "OPH",  2.56, HmsToDeg(16, 37.0, 0), DmsToDeg(-10, 34, 0)},
    {"",                     "OPH",  3.20, HmsToDeg(16, 57.6, 0), DmsToDeg( +9, 22, 0)},
    {"",                     "OPH",  3.30, HmsToDeg(17, 21.9, 0), DmsToDeg(-24, 59, 0)},
    {"",                     "OPH",  3.34, HmsToDeg(17, 58.8, 0), DmsToDeg( -9, 46, 0)},
    {"",                     "ORI",  3.40, HmsToDeg( 5, 24.3, 0), DmsToDeg( -2, 24, 0)},
    {"",                     "PAV",  3.42, HmsToDeg(20, 44.6, 0), DmsToDeg(-66, 13, 0)},
    {"",                     "PEG",  3.48, HmsToDeg(22, 49.9, 0), DmsToDeg(+24, 35, 0)},
    {"",                     "PER",  2.85, HmsToDeg( 3, 54.0, 0), DmsToDeg(+31, 52, 0)},
    {"",                     "PER",  2.89, HmsToDeg( 3, 57.6, 0), DmsToDeg(+40,  0, 0)},
    {"",                     "PER",  2.93, HmsToDeg( 3,  4.5, 0), DmsToDeg(+53, 29, 0)},
    {"",                     "PER",  3.01, HmsToDeg( 3, 42.7, 0), DmsToDeg(+47, 46, 0)},
    {"",                     "PER",  3.40, HmsToDeg( 3,  5.0, 0), DmsToDeg(+38, 49, 0)},
    {"",                     "PHE",  3.31, HmsToDeg( 1,  5.9, 0), DmsToDeg(-46, 44, 0)},
    {"",                     "PHE",  3.40, HmsToDeg( 1, 28.3, 0), DmsToDeg(-43, 20, 0)},
    {"",                     "PIC",  3.27, HmsToDeg( 6, 48.3, 0), DmsToDeg(-61, 56, 0)},
    {"",                     "PUP",  2.70, HmsToDeg( 7, 17.0, 0), DmsToDeg(-37,  6, 0)},
    {"",                     "PUP",  2.80, HmsToDeg( 8,  7.5, 0), DmsToDeg(-24, 17, 0)},
    {"",                     "PUP",  2.93, HmsToDeg( 6, 49.8, 0), DmsToDeg(-50, 36, 0)},
    {"",                     "PUP",  3.17, HmsToDeg( 6, 37.6, 0), DmsToDeg(-43, 11, 0)},
    {"",                     "PUP",  3.25, HmsToDeg( 7, 29.1, 0), DmsToDeg(-43, 18, 0)},
    {"",                     "PUP",  3.34, HmsToDeg( 7, 49.3, 0), DmsToDeg(-24, 51, 0)},
    {"",                     "RET",  3.35, HmsToDeg( 4, 14.4, 0), DmsToDeg(-62, 29, 0)},
    {"",                     "SCO",  2.29, HmsToDeg(16, 50.0, 0), DmsToDeg(-34, 17, 0)},
    {"",                     "SCO",  2.40, HmsToDeg(17, 42.3, 0), DmsToDeg(-39,  2, 0)},
    {"",                     "SCO",  2.69, HmsToDeg(17, 30.6, 0), DmsToDeg(-37, 17, 0)},
    {"",                     "SCO",  2.82, HmsToDeg(16, 35.7, 0), DmsToDeg(-28, 13, 0)},
    {"",                     "SCO",  2.89, HmsToDeg(15, 58.8, 0), DmsToDeg(-26,  6, 0)},
    {"",                     "SCO",  2.90, HmsToDeg(16, 21.0, 0), DmsToDeg(-25, 35, 0)},
    {"",                     "SCO",  3.03, HmsToDeg(17, 47.4, 0), DmsToDeg(-40,  7, 0)},
    {"",                     "SCO",  3.10, HmsToDeg(16, 51.7, 0), DmsToDeg(-38,  3, 0)},
    {"",                     "SCO",  3.33, HmsToDeg(17, 11.9, 0), DmsToDeg(-43, 14, 0)},
    {"",                     "SER",  3.26, HmsToDeg(18, 21.2, 0), DmsToDeg( -2, 54, 0)},
    {"",                     "SER",  3.53, HmsToDeg(15, 49.5, 0), DmsToDeg( -3, 25, 0)},
    {"",                     "SER",  3.54, HmsToDeg(17, 37.4, 0), DmsToDeg(-15, 24, 0)},
    {"",                     "SGE",  3.47, HmsToDeg(19, 58.7, 0), DmsToDeg(+19, 29, 0)},
    {"",                     "SGR",  3.11, HmsToDeg(18, 17.4, 0), DmsToDeg(-36, 46, 0)},
    {"",                     "SGR",  3.17, HmsToDeg(18, 45.5, 0), DmsToDeg(-27,  0, 0)},
    {"",                     "SGR",  3.32, HmsToDeg(19,  6.8, 0), DmsToDeg(-27, 40, 0)},
    {"",                     "SGR",  3.51, HmsToDeg(18, 57.6, 0), DmsToDeg(-21,  7, 0)},
    {"",                     "TAU",  3.00, HmsToDeg( 5, 37.5, 0), DmsToDeg(+21,  8, 0)},
    {"",                     "TAU",  3.40, HmsToDeg( 4, 28.4, 0), DmsToDeg(+15, 52, 0)},
    {"",                     "TAU",  3.50, HmsToDeg( 4,  0.5, 0), DmsToDeg(+12, 29, 0)},
    {"",                     "TEL",  3.51, HmsToDeg(18, 26.7, 0), DmsToDeg(-45, 58, 0)},
    {"",                     "TRA",  2.85, HmsToDeg(15, 54.8, 0), DmsToDeg(-63, 25, 0)},
    {"",                     "TRA",  2.89, HmsToDeg(15, 18.6, 0), DmsToDeg(-68, 39, 0)},
    {"",                     "TRI",  3.00, HmsToDeg( 2,  9.4, 0), DmsToDeg(+34, 58, 0)},
    {"",                     "TUC",  2.86, HmsToDeg(22, 18.3, 0), DmsToDeg(-60, 17, 0)},
    {"",                     "UMA",  3.01, HmsToDeg(11,  9.5, 0), DmsToDeg(+44, 31, 0)},
    {"",                     "UMA",  3.17, HmsToDeg( 9, 32.7, 0), DmsToDeg(+51, 42, 0)},
    {"",                     "UMA",  3.40, HmsToDeg( 8, 30.0, 0), DmsToDeg(+60, 44, 0)},
    {"",                     "VEL",  1.96, HmsToDeg( 8, 44.6, 0), DmsToDeg(-54, 41, 0)},
    {"",                     "VEL",  2.50, HmsToDeg( 9, 22.0, 0), DmsToDeg(-55,  0, 0)},
    {"",                     "VEL",  2.69, HmsToDeg(10, 46.7, 0), DmsToDeg(-49, 24, 0)},
    {"",                     "VEL",  3.54, HmsToDeg( 9, 56.7, 0), DmsToDeg(-54, 33, 0)},
    {"Acamar",               "ERI",  3.42, HmsToDeg( 2, 58.1, 0), DmsToDeg(-40, 20, 0)},
    {"Achernar",             "ERI",  0.46, HmsToDeg( 1, 37.5, 0), DmsToDeg(-57, 15, 0)},
    {"Acrux",                "CRU",  1.33, HmsToDeg(12, 26.4, 0), DmsToDeg(-63,  4, 0)},
    {"Adara",                "CMA",  1.50, HmsToDeg( 6, 58.4, 0), DmsToDeg(-28, 58, 0)},
    {"Adhafera",             "LEO",  3.44, HmsToDeg(10, 16.5, 0), DmsToDeg(+23, 26, 0)},
    {"Ain",                  "TAU",  3.53, HmsToDeg( 4, 28.6, 0), DmsToDeg(+19, 10, 0)},
    {"Al Anz",               "AUR",  3.04, HmsToDeg( 5,  1.7, 0), DmsToDeg(+43, 50, 0)},
    {"Al Nair",              "GRU",  1.74, HmsToDeg(22,  8.0, 0), DmsToDeg(-47,  0, 0)},
    {"Albaldah",             "SGR",  2.89, HmsToDeg(19,  9.6, 0), DmsToDeg(-21,  1, 0)},
    {"Albireo",              "CYG",  3.08, HmsToDeg(19, 30.5, 0), DmsToDeg(+27, 57, 0)},
    {"Alcyone",              "TAU",  2.87, HmsToDeg( 3, 47.4, 0), DmsToDeg(+24,  5, 0)},
    {"Aldebaran",            "TAU",  0.85, HmsToDeg( 4, 35.7, 0), DmsToDeg(+16, 30, 0)},
    {"Alderamin",            "CEP",  2.44, HmsToDeg(21, 18.4, 0), DmsToDeg(+62, 34, 0)},
    {"Aldhibah",             "DRA",  3.17, HmsToDeg(17,  8.8, 0), DmsToDeg(+65, 44, 0)},
    {"Algenib",              "PEG",  2.80, HmsToDeg( 0, 13.1, 0), DmsToDeg(+15, 10, 0)},
    {"Algieba",              "LEO",  2.61, HmsToDeg(10, 19.8, 0), DmsToDeg(+19, 52, 0)},
    {"Algol",                "PER",  2.10, HmsToDeg( 3,  8.0, 0), DmsToDeg(+40, 56, 0)},
    {"Algorab",              "CRV",  2.95, HmsToDeg(12, 29.7, 0), DmsToDeg(-16, 29, 0)},
    {"Alhena",               "GEM",  1.93, HmsToDeg( 6, 37.5, 0), DmsToDeg(+16, 25, 0)},
    {"Alioth",               "UMA",  1.80, HmsToDeg(12, 54.0, 0), DmsToDeg(+56,  0, 0)},
    {"Alkaid",               "UMA",  1.86, HmsToDeg(13, 47.2, 0), DmsToDeg(+49, 21, 0)},
    {"Almaak",               "AND",  2.26, HmsToDeg( 2,  3.7, 0), DmsToDeg(+42, 19, 0)},
    {"Alnath",               "TAU",  1.65, HmsToDeg( 5, 26.2, 0), DmsToDeg(+28, 36, 0)},
    {"Alnilam",              "ORI",  1.70, HmsToDeg( 5, 36.1, 0), DmsToDeg( -1, 12, 0)},
    {"Alnitak",              "ORI",  2.05, HmsToDeg( 5, 40.6, 0), DmsToDeg( -1, 57, 0)},
    {"Alphard",              "HYA",  1.98, HmsToDeg( 9, 27.5, 0), DmsToDeg( -8, 39, 0)},
    {"Alphekka",             "CRB",  2.20, HmsToDeg(15, 34.6, 0), DmsToDeg(+26, 44, 0)},
    {"Alpheratz",            "AND",  2.10, HmsToDeg( 0,  8.2, 0), DmsToDeg(+29,  4, 0)},
    {"Alphirk",              "CEP",  3.20, HmsToDeg(21, 28.6, 0), DmsToDeg(+70, 33, 0)},
    {"Alrai",                "CEP",  3.21, HmsToDeg(23, 39.3, 0), DmsToDeg(+77, 36, 0)},
    {"Altair",               "AQL",  0.77, HmsToDeg(19, 50.7, 0), DmsToDeg( +8, 51, 0)},
    {"Altarf",               "CNC",  3.52, HmsToDeg( 8, 16.3, 0), DmsToDeg( +9, 12, 0)},
    {"Aludra",               "CMA",  2.45, HmsToDeg( 7, 23.9, 0), DmsToDeg(-29, 18, 0)},
    {"Alula Borealis",       "UMA",  3.48, HmsToDeg(11, 18.3, 0), DmsToDeg(+33,  7, 0)},
    {"Alzirr",               "GEM",  3.36, HmsToDeg( 6, 45.1, 0), DmsToDeg(+12, 54, 0)},
    {"Ankaa",                "PHE",  2.39, HmsToDeg( 0, 26.2, 0), DmsToDeg(-42, 20, 0)},
    {"Antares",              "SCO",  0.90, HmsToDeg(16, 29.3, 0), DmsToDeg(-26, 26, 0)},
    {"Arcturus",             "BOO", -0.04, HmsToDeg(14, 15.6, 0), DmsToDeg(+19, 12, 0)},
    {"Arneb",                "LEP",  2.58, HmsToDeg( 5, 32.7, 0), DmsToDeg(-17, 50, 0)},
    {"Ascella",              "SGR",  2.60, HmsToDeg(19,  2.4, 0), DmsToDeg(-29, 53, 0)},
    {"Atria",                "TRA",  1.92, HmsToDeg(16, 48.2, 0), DmsToDeg(-69,  2, 0)},
    {"Auva",                 "VIR",  3.38, HmsToDeg(12, 55.4, 0), DmsToDeg( +3, 25, 0)},
    {"Avior",                "CAR",  1.86, HmsToDeg( 8, 22.4, 0), DmsToDeg(-59, 30, 0)},
    {"Baham",                "PEG",  3.53, HmsToDeg(22, 10.1, 0), DmsToDeg( +6, 11, 0)},
    {"Becrux",               "CRU",  1.20, HmsToDeg(12, 47.6, 0), DmsToDeg(-59, 40, 0)},
    {"Bellatrix",            "ORI",  1.64, HmsToDeg( 5, 25.0, 0), DmsToDeg( +6, 20, 0)},
    {"Betelgeuse",           "ORI",  0.50, HmsToDeg( 5, 55.0, 0), DmsToDeg( +7, 24, 0)},
    {"Brachium",             "LIB",  3.30, HmsToDeg(15,  3.8, 0), DmsToDeg(-25, 15, 0)},
    {"Canopus",              "CAR", -0.72, HmsToDeg( 6, 23.8, 0), DmsToDeg(-52, 41, 0)},
    {"Capella",              "AUR",  0.08, HmsToDeg( 5, 16.4, 0), DmsToDeg(+45, 59, 0)},
    {"Caph",                 "CAS",  2.30, HmsToDeg( 0,  9.0, 0), DmsToDeg(+59,  8, 0)},
    {"Castor",               "GEM",  1.94, HmsToDeg( 7, 34.4, 0), DmsToDeg(+31, 54, 0)},
    {"Cebalrai",             "OPH",  2.77, HmsToDeg(17, 43.3, 0), DmsToDeg( +4, 34, 0)},
    {"Chort",                "LEO",  3.34, HmsToDeg(11, 14.0, 0), DmsToDeg(+15, 27, 0)},
    {"Cor Caroli",           "CVN",  2.90, HmsToDeg(12, 55.9, 0), DmsToDeg(+38, 20, 0)},
    {"Dabih",                "CAP",  3.08, HmsToDeg(20, 20.8, 0), DmsToDeg(-14, 48, 0)},
    {"Deneb",                "CYG",  1.25, HmsToDeg(20, 41.3, 0), DmsToDeg(+45, 16, 0)},
    {"Denebola",             "LEO",  2.14, HmsToDeg(11, 48.9, 0), DmsToDeg(+14, 36, 0)},
    {"Diphda",               "CET",  2.04, HmsToDeg( 0, 43.5, 0), DmsToDeg(-18,  1, 0)},
    {"Dschubba",             "SCO",  2.32, HmsToDeg(16,  0.2, 0), DmsToDeg(-22, 37, 0)},
    {"Dubhe",                "UMA",  1.79, HmsToDeg(11,  3.6, 0), DmsToDeg(+61, 46, 0)},
    {"Ed Asich",             "DRA",  3.29, HmsToDeg(15, 24.8, 0), DmsToDeg(+58, 59, 0)},
    {"Enif",                 "PEG",  2.40, HmsToDeg(21, 44.0, 0), DmsToDeg( +9, 51, 0)},
    {"Etamin",               "DRA",  2.23, HmsToDeg(17, 56.5, 0), DmsToDeg(+51, 29, 0)},
    {"Fomalhaut",            "PSA",  1.16, HmsToDeg(22, 57.5, 0), DmsToDeg(-29, 39, 0)},
    {"Gacrux",               "CRU",  1.63, HmsToDeg(12, 31.0, 0), DmsToDeg(-57,  5, 0)},
    {"Gienah Ghurab",        "CRV",  2.59, HmsToDeg(12, 15.7, 0), DmsToDeg(-17, 31, 0)},
    {"Gomeisa",              "CMI",  2.90, HmsToDeg( 7, 27.0, 0), DmsToDeg( +8, 18, 0)},
    {"Graffias",             "SCO",  2.62, HmsToDeg(16,  5.2, 0), DmsToDeg(-19, 48, 0)},
    {"HR2748",               "PUP",  2.60, HmsToDeg( 7, 13.4, 0), DmsToDeg(-44, 38, 0)},
    {"HR3659",               "CAR",  3.44, HmsToDeg( 9, 10.9, 0), DmsToDeg(-58, 56, 0)},
    {"HR3803",               "VEL",  3.13, HmsToDeg( 9, 31.0, 0), DmsToDeg(-57,  1, 0)},
    {"HR3884",               "CAR",  3.80, HmsToDeg( 9, 45.2, 0), DmsToDeg(-62, 30, 0)},
    {"HR4050",               "CAR",  3.40, HmsToDeg(10, 16.9, 0), DmsToDeg(-61, 19, 0)},
    {"HR4140",               "CAR",  3.30, HmsToDeg(10, 31.8, 0), DmsToDeg(-61, 40, 0)},
    {"HR6630",               "SCO",  3.21, HmsToDeg(17, 49.6, 0), DmsToDeg(-37,  2, 0)},
    {"Hadar",                "CEN",  0.60, HmsToDeg(14,  3.6, 0), DmsToDeg(-60, 21, 0)},
    {"Hamal",                "ARI",  2.00, HmsToDeg( 2,  7.0, 0), DmsToDeg(+23, 27, 0)},
    {"Hassaleh",             "ORI",  3.19, HmsToDeg( 4, 49.7, 0), DmsToDeg( +6, 58, 0)},
    {"Heze",                 "VIR",  3.37, HmsToDeg(13, 34.6, 0), DmsToDeg( -0, 35, 0)},
    {"Hoedus II",            "AUR",  3.17, HmsToDeg( 5,  6.3, 0), DmsToDeg(+41, 13, 0)},
    {"Homam",                "PEG",  3.40, HmsToDeg(22, 41.3, 0), DmsToDeg(+10, 49, 0)},
    {"Izar",                 "BOO",  2.37, HmsToDeg(14, 44.8, 0), DmsToDeg(+27,  5, 0)},
    {"Kaffaljidhma",         "CET",  3.47, HmsToDeg( 2, 43.2, 0), DmsToDeg( +3, 14, 0)},
    {"Kaus Australis",       "SGR",  1.85, HmsToDeg(18, 24.0, 0), DmsToDeg(-34, 23, 0)},
    {"Kaus Borealis",        "SGR",  2.81, HmsToDeg(18, 27.8, 0), DmsToDeg(-25, 26, 0)},
    {"Kaus Meridionalis",    "SGR",  2.70, HmsToDeg(18, 20.8, 0), DmsToDeg(-29, 50, 0)},
    {"Kocab",                "UMI",  2.08, HmsToDeg(14, 50.7, 0), DmsToDeg(+74, 11, 0)},
    {"Kornephoros",          "HER",  2.77, HmsToDeg(16, 30.2, 0), DmsToDeg(+21, 30, 0)},
    {"Kraz",                 "CRV",  2.65, HmsToDeg(12, 34.2, 0), DmsToDeg(-23, 22, 0)},
    {"Kursa",                "ERI",  2.79, HmsToDeg( 5,  7.7, 0), DmsToDeg( -5,  6, 0)},
    {"Markab",               "PEG",  2.49, HmsToDeg(23,  4.6, 0), DmsToDeg(+15, 11, 0)},
    {"Matar",                "PEG",  2.94, HmsToDeg(22, 42.8, 0), DmsToDeg(+30, 12, 0)},
    {"Mebsuta",              "GEM",  2.98, HmsToDeg( 6, 43.8, 0), DmsToDeg(+25,  9, 0)},
    {"Megrez",               "UMA",  3.31, HmsToDeg(12, 15.3, 0), DmsToDeg(+57,  3, 0)},
    {"Meissa",               "ORI",  3.54, HmsToDeg( 5, 35.0, 0), DmsToDeg( +9, 56, 0)},
    {"Menkalinan",           "AUR",  1.90, HmsToDeg( 5, 59.3, 0), DmsToDeg(+44, 57, 0)},
    {"Menkar",               "CET",  2.53, HmsToDeg( 3,  2.1, 0), DmsToDeg( +4,  4, 0)},
    {"Menkent",              "CEN",  2.06, HmsToDeg(14,  6.6, 0), DmsToDeg(-36, 21, 0)},
    {"Merak",                "UMA",  2.37, HmsToDeg(11,  1.7, 0), DmsToDeg(+56, 24, 0)},
    {"Metallah",             "TRI",  3.41, HmsToDeg( 1, 52.9, 0), DmsToDeg(+29, 34, 0)},
    {"Miaplacidus",          "CAR",  1.68, HmsToDeg( 9, 13.2, 0), DmsToDeg(-69, 41, 0)},
    {"Minkar",               "CRV",  3.00, HmsToDeg(12, 10.0, 0), DmsToDeg(-22, 36, 0)},
    {"Mintaka",              "ORI",  2.23, HmsToDeg( 5, 31.9, 0), DmsToDeg( -0, 18, 0)},
    {"Mira",                 "CET",  2.00, HmsToDeg( 2, 19.2, 0), DmsToDeg( -3,  1, 0)},
    {"Mirach",               "AND",  2.06, HmsToDeg( 1,  9.5, 0), DmsToDeg(+35, 36, 0)},
    {"Mirphak",              "PER",  1.79, HmsToDeg( 3, 24.1, 0), DmsToDeg(+49, 50, 0)},
    {"Mizar",                "UMA",  2.27, HmsToDeg(13, 23.7, 0), DmsToDeg(+54, 58, 0)},
    {"Mufrid",               "BOO",  2.68, HmsToDeg(13, 54.6, 0), DmsToDeg(+18, 25, 0)},
    {"Murzim",               "CMA",  2.00, HmsToDeg( 6, 22.6, 0), DmsToDeg(-17, 57, 0)},
    {"Nair al Saif",         "ORI",  2.77, HmsToDeg( 5, 35.3, 0), DmsToDeg( -5, 55, 0)},
    {"Naos",                 "PUP",  2.25, HmsToDeg( 8,  3.4, 0), DmsToDeg(-39, 59, 0)},
    {"Nash",                 "SGR",  2.99, HmsToDeg(18,  5.6, 0), DmsToDeg(-30, 25, 0)},
    {"Nekkar",               "BOO",  3.50, HmsToDeg(15,  1.7, 0), DmsToDeg(+40, 25, 0)},
    {"Nodus Secundus",       "DRA",  3.07, HmsToDeg(19, 12.6, 0), DmsToDeg(+67, 40, 0)},
    {"Nunki",                "SGR",  2.02, HmsToDeg(18, 55.1, 0), DmsToDeg(-26, 19, 0)},
    {"Peacock",              "PAV",  1.94, HmsToDeg(20, 25.4, 0), DmsToDeg(-56, 45, 0)},
    {"Phad",                 "UMA",  2.44, HmsToDeg(11, 53.7, 0), DmsToDeg(+53, 43, 0)},
    {"Phaet",                "COL",  2.64, HmsToDeg( 5, 39.5, 0), DmsToDeg(-34,  5, 0)},
    {"Pherkad",              "UMI",  3.05, HmsToDeg(15, 20.7, 0), DmsToDeg(+71, 51, 0)},
    {"Phurud",               "CMA",  3.02, HmsToDeg( 6, 20.1, 0), DmsToDeg(-30,  3, 0)},
    {"Polaris",              "UMI",  2.00, HmsToDeg( 2, 27.9, 0), DmsToDeg(+89, 15, 0)},
    {"Pollux",               "GEM",  1.14, HmsToDeg( 7, 45.2, 0), DmsToDeg(+28,  2, 0)},
    {"Porrima",              "VIR",  2.76, HmsToDeg(12, 41.5, 0), DmsToDeg( -1, 26, 0)},
    {"Procyon",              "CMI",  0.38, HmsToDeg( 7, 39.2, 0), DmsToDeg( +5, 14, 0)},
    {"Propus",               "GEM",  3.30, HmsToDeg( 6, 14.7, 0), DmsToDeg(+22, 31, 0)},
    {"Ras Algethi",          "HER",  3.10, HmsToDeg(17, 14.6, 0), DmsToDeg(+14, 24, 0)},
    {"Ras Elased Australis", "LEO",  2.98, HmsToDeg( 9, 45.7, 0), DmsToDeg(+23, 47, 0)},
    {"Rasalhague",           "OPH",  2.08, HmsToDeg(17, 34.9, 0), DmsToDeg(+12, 34, 0)},
    {"Regulus",              "LEO",  1.35, HmsToDeg(10,  8.2, 0), DmsToDeg(+12,  0, 0)},
    {"Restaban",             "DRA",  2.79, HmsToDeg(17, 30.3, 0), DmsToDeg(+52, 19, 0)},
    {"Rigel",                "ORI",  0.12, HmsToDeg( 5, 14.7, 0), DmsToDeg( -8, 13, 0)},
    {"Rigil Kentaurus",      "CEN", -0.01, HmsToDeg(14, 39.5, 0), DmsToDeg(-60, 49, 0)},
    {"Ruchbah",              "CAS",  2.70, HmsToDeg( 1, 25.6, 0), DmsToDeg(+60, 13, 0)},
    {"Sabik",                "OPH",  2.43, HmsToDeg(17, 10.2, 0), DmsToDeg(-15, 43, 0)},
    {"Sadalmelik",           "AQR",  2.96, HmsToDeg(22,  5.6, 0), DmsToDeg( -0, 20, 0)},
    {"Sadalsuud",            "AQR",  2.91, HmsToDeg(21, 31.4, 0), DmsToDeg( -5, 35, 0)},
    {"Sadr",                 "CYG",  2.20, HmsToDeg(20, 22.0, 0), DmsToDeg(+40, 14, 0)},
    {"Saiph",                "ORI",  2.06, HmsToDeg( 5, 47.7, 0), DmsToDeg( -9, 40, 0)},
    {"Sargas",               "SCO",  1.87, HmsToDeg(17, 37.1, 0), DmsToDeg(-43,  0, 0)},
    {"Sarin",                "HER",  3.14, HmsToDeg(17, 14.9, 0), DmsToDeg(+24, 51, 0)},
    {"Scheat",               "PEG",  2.40, HmsToDeg(23,  3.7, 0), DmsToDeg(+28,  4, 0)},
    {"Schedar",              "CAS",  2.23, HmsToDeg( 0, 40.3, 0), DmsToDeg(+56, 31, 0)},
    {"Segin",                "CAS",  3.38, HmsToDeg( 1, 54.1, 0), DmsToDeg(+63, 39, 0)},
    {"Seginus",              "BOO",  3.03, HmsToDeg(14, 31.9, 0), DmsToDeg(+38, 19, 0)},
    {"Sharatan",             "ARI",  2.64, HmsToDeg( 1, 54.5, 0), DmsToDeg(+20, 47, 0)},
    {"Shaula",               "SCO",  1.60, HmsToDeg(17, 33.4, 0), DmsToDeg(-37,  6, 0)},
    {"Sheliak",              "LYR",  3.40, HmsToDeg(18, 49.9, 0), DmsToDeg(+33, 21, 0)},
    {"Sirius",               "CMA", -1.46, HmsToDeg( 6, 45.1, 0), DmsToDeg(-16, 42, 0)},
    {"Skat",                 "AQR",  3.27, HmsToDeg(22, 54.6, 0), DmsToDeg(-15, 51, 0)},
    {"Spica",                "VIR",  1.00, HmsToDeg(13, 25.0, 0), DmsToDeg(-11,  8, 0)},
    {"Subra",                "LEO",  3.52, HmsToDeg( 9, 41.0, 0), DmsToDeg( +9, 54, 0)},
    {"Suhail al Muhlif",     "VEL",  1.80, HmsToDeg( 8,  9.4, 0), DmsToDeg(-47, 19, 0)},
    {"Suhail",               "VEL",  2.21, HmsToDeg( 9,  7.8, 0), DmsToDeg(-43, 24, 0)},
    {"Sulaphat",             "LYR",  3.24, HmsToDeg(18, 58.7, 0), DmsToDeg(+32, 41, 0)},
    {"Talitha",              "UMA",  3.14, HmsToDeg( 8, 59.0, 0), DmsToDeg(+48,  4, 0)},
    {"Tania Australis",      "UMA",  3.05, HmsToDeg(10, 22.2, 0), DmsToDeg(+41, 31, 0)},
    {"Tania Borealis",       "UMA",  3.45, HmsToDeg(10, 17.0, 0), DmsToDeg(+42, 56, 0)},
    {"Tarazed",              "AQL",  2.72, HmsToDeg(19, 46.1, 0), DmsToDeg(+10, 36, 0)},
    {"Tejat Posterior",      "GEM",  2.90, HmsToDeg( 6, 22.8, 0), DmsToDeg(+22, 31, 0)},
    {"Turais",               "CAR",  2.20, HmsToDeg( 9, 17.0, 0), DmsToDeg(-59, 16, 0)},
    {"Unukalhai",            "SER",  2.65, HmsToDeg(15, 44.1, 0), DmsToDeg( +6, 26, 0)},
    {"Vega",                 "LYR",  0.03, HmsToDeg(18, 36.8, 0), DmsToDeg(+38, 46, 0)},
    {"Vindamiatrix",         "VIR",  2.83, HmsToDeg(13,  2.1, 0), DmsToDeg(+10, 59, 0)},
    {"Wasat",                "GEM",  3.53, HmsToDeg( 7, 20.0, 0), DmsToDeg(+21, 59, 0)},
    {"Wezen",                "CMA",  1.84, HmsToDeg( 7,  8.2, 0), DmsToDeg(-26, 24, 0)},
    {"Wezn",                 "COL",  3.12, HmsToDeg( 5, 50.8, 0), DmsToDeg(-35, 46, 0)},
    {"Yed Posterior",        "OPH",  3.24, HmsToDeg(16, 18.2, 0), DmsToDeg( -4, 41, 0)},
    {"Yed Prior",            "OPH",  2.74, HmsToDeg(16, 14.2, 0), DmsToDeg( -3, 41, 0)},
    {"Yildun",               "UMI",  4.35, HmsToDeg(17, 32,  13), DmsToDeg(+86, 35,11)},
    {"Zaurak",               "ERI",  2.95, HmsToDeg( 3, 57.9, 0), DmsToDeg(-13, 31, 0)},
    {"Zosma",                "LEO",  2.56, HmsToDeg(11, 14.0, 0), DmsToDeg(+20, 33, 0)},
    {"Zuben Elgenubi",       "LIB",  2.75, HmsToDeg(14, 50.7, 0), DmsToDeg(-16,  1, 0)},
    {"Zuben Elschemali",     "LIB",  2.61, HmsToDeg(15, 16.8, 0), DmsToDeg( -9, 22, 0)},

    {NULL, NULL, 0.0, 8.0, 0.0}
};


