CFlare* FlareList[] = {
    //  CFlare(CDateTime(YYYY,MM,DD, HH,MM,SS), mag, alt, azim, satnum),
    new CFlare(CDateTime(2013, 8,26, 19,55,57), -3.5, 71.0, 142.0, 65),
    new CFlare(CDateTime(2013, 8,27,  8, 6,36), -6.2, 57.0,  61.0, 75),
    new CFlare(CDateTime(2013, 8,28,  4,41,25), -8.1, 52.0, 238.0, 52),
    new CFlare(CDateTime(2013, 8,28, 21,28,53), -1.3, 48.0,  90.0, 76),
    new CFlare(CDateTime(2013, 8,29,  4,35,21), -3.1, 52.0, 239.0, 10),
    new CFlare(CDateTime(2013, 8,29, 21,22,52), -2.3, 46.0,  91.0, 46),
    new CFlare(CDateTime(2013, 8,30, 21,16,49), -1.6, 47.0,  93.0, 49),
    new CFlare(CDateTime(2013, 9, 1, 18,36,26), -7.9, 61.0, 333.0, 98),
    new CFlare(CDateTime(2013, 9, 3, 21, 1,52), -2.2, 54.0, 102.0,  3),
    new CFlare(CDateTime(2013, 9, 4, 20,55,48), -7.2, 54.0, 105.0, 76),
    new CFlare(CDateTime(2013, 9, 5,  5,47,41), -0.8, 58.0, 198.0, 77),
    new CFlare(CDateTime(2013, 9, 6,  5,41,37), -0.5, 59.0, 192.0, 82),
    NULL
};

